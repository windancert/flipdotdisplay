## firmware/main/Kconfig.projbuild
```kconfig
menu "Flip-dot display"

    config FLIPDOT_UDP_PORT
        int "UDP port for incoming frames"
        range 1 65535
        default 7777

    config FLIPDOT_BOOT_TEST
        bool "Show the panel orientation test at boot"
        default n
        help
            Lights a corner marker on each panel in turn, so the layout table in
            local_config.h can be checked against the physical wiring.

    config FLIPDOT_DIRECT_DRIVE
        bool "Direct drive (no 74HCT595 shift registers)"
        default y if IDF_TARGET_ESP32S3
        default n
        help
            Drives the panel logic lines straight from the GPIOs instead of through
            the three 74HCT595 shift registers. The pin maps are in
            panel_hw_direct.c: two panels (COL-SEL0/1) on the C6, eight on the S3.
            The shift-register driver only exists for the C6.

endmenu
```
